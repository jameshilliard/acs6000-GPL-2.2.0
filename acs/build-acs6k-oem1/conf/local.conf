## common/com.avocent.dev/conf/machine/pmhd-x86.conf
```bitbake
#@TYPE: Machine
#@NAME: Avocent PMHD
#@DESCRIPTION: Machine configuration for the PMHD-VM  devices

TARGET_ARCH = "i686"

PRODUCT ?= "pmhd-vm"
OVERRIDES =. "${PRODUCT}:"

PREFERRED_PROVIDER_virtual/kernel = "linux-acs6k-x86"
BOOTSTRAP_EXTRA_DEPENDS = "virtual/kernel"

IMAGE_DEVICE_TABLES = "files/device_table-minimal.txt"

#ROOT_FLASH_SIZE = "100"

MODUTILS = "26"	
PCMCIA_MANAGER = "pcmciautils"
BOOTSTRAP_EXTRA_RDEPENDS += "kernel udev module-init-tools ${PCMCIA_MANAGER}"
BOOTSTRAP_EXTRA_RRECOMMENDS += "kernel-modules kernel-modules-2.6" 

# Used by sysvinit package, rebuild sysvinit after modify these variables
# Set serial console to ttyS0,bitrate 38400. disable tty? VT 
USE_VT = "0"
GETTY = "getty"
SERIAL_CONSOLE = "ttyS0"
BOOTSTRAP_EXTRA_RDEPENDS += "util-linux"
```

## common/com.avocent.dev/conf/machine/pmhd_mpc8313.conf
```bitbake
#@TYPE: Machine
#@NAME: Avocent PMHD
#@DESCRIPTION: Machine configuration for the Avocent PMHD

TARGET_ARCH = "powerpc"

PRODUCT ?= "pmhd"
OVERRIDES =. "${PRODUCT}:"

PREFERRED_PROVIDER_virtual/kernel = "linux-pmhd"

#ROOT_FLASH_SIZE = "100"

MODUTILS = "26"	
BOOTSTRAP_EXTRA_RDEPENDS += "kernel udev module-init-tools"
BOOTSTRAP_EXTRA_RRECOMMENDS += "kernel-modules kernel-modules-2.6" 

# Used by sysvinit package, rebuild sysvinit after modify these variables
# Set serial console to ttyS0,bitrate 38400. disable tty? VT 
USE_VT = "0"
GETTY = "getty"
SERIAL_CONSOLE = "ttyS0"
BOOTSTRAP_EXTRA_RDEPENDS += "util-linux"
```

## common/org.openembedded.dev/conf/distro/caesar.conf
```bitbake
MAINTAINER ?= "Jiff Shen <jiff.shen@avocent.com>"

DISTRO = "caesar"
DISTRO_NAME = "CAESAR"
DISTRO_VERSION = "1.0.0-${DATE}"

INHERIT += "package_ipk debian multimachine" 
TARGET_OS = "linux"

RESCUE_IMAGE_BASENAME = "rescue"
IMAGE_NAME = "${IMAGE_BASENAME}-${DISTRO_VERSION}-${MACHINE}"

ENABLE_BINARY_LOCALE_GENERATION ?= "1"
PARALLEL_INSTALL_MODULES = "1"
UDEV_DEVFS_RULES = "0"

DISTRO_CHECK := "${@bb.data.getVar("DISTRO_VERSION",d,1) or bb.fatal('Remove this line or set a dummy DISTRO_VERSION if you really want to build an unversioned distro')}"

#DISTRO_TYPE = "debug"
DISTRO_TYPE = "release"

#SRCDATE = 20050331
#SRCDATE = "now"

#Make sure we use 2.6 on machines with a 2.4/2.6 selector
KERNEL = "kernel26"
MACHINE_KERNEL_VERSION = "2.6"

PREFERRED_PROVIDERS += "virtual/${TARGET_PREFIX}gcc-initial:gcc-cross-initial"
PREFERRED_PROVIDERS += "virtual/${TARGET_PREFIX}gcc:gcc-cross"
PREFERRED_PROVIDERS += "virtual/${TARGET_PREFIX}g++:gcc-cross"
PREFERRED_PROVIDERS += "virtual/${TARGET_PREFIX}libc-for-gcc:glibc-intermediate"

PREFERRED_PROVIDER_virtual/libiconv = "glibc"
PREFERRED_PROVIDER_virtual/libintl = "glibc"
PREFERRED_PROVIDER_virtual/ntp = "ntp"
PREFERRED_PROVIDER_virtual/db = "db"

PREFERRED_PROVIDER_task-bootstrap = "task-bootstrap"

# Tool chain
PREFERRED_VERSION_binutils ?= "2.15.94.0.1"
PREFERRED_VERSION_binutils-cross ?= "2.15.94.0.1"
PREFERRED_VERSION_gcc ?= "3.3.4"
PREFERRED_VERSION_gcc-initial ?= "3.3.4"
PREFERRED_VERSION_gcc-cross ?= "3.3.4"
PREFERRED_VERSION_gcc-cross-initial ?= "3.3.4"
PREFERRED_VERSION_glibc-initial ?= "2.3.5"
PREFERRED_VERSION_glibc ?= "2.3.5"
PREFERRED_VERSION_glibc-intermediate ?= "2.3.5"
PREFERRED_VERSION_linux-libc-headers ?= "2.6.11.1"
PREFERRED_VERSION_flex-native ?= "2.5.33"

# base apps
PREFERRED_VERSION_grub ?= "0.96"
PREFERRED_VERSION_udev ?= "100"
PREFERRED_VERSION_shadow ?= "4.0.14"

PREFERRED_VERSION_gdb ?= "6.2.1"
PREFERRED_VERSION_openssl ?= "0.9.7e"
PREFERRED_VERSION_openssh ?= "4.0p1"
PREFERRED_VERSION_tcl ?= "8.4.11"

PREFERRED_VERSION_db-native ?= 4.2.52
PREFERRED_VERSION_db ?= 4.2.52

PREFERRED_VERSION_apache ?= "2.0.55"
#PREFERRED_VERSION_autoconf-native ?= "2.59"
#PREFERRED_VERSION_automake-native ?= "1.9.3"
PREFERRED_VERSION_base-files ?= "3.0.14"
PREFERRED_VERSION_base-passwd ?= "3.5.9"
PREFERRED_VERSION_bash ?= "3.0"
#PREFERRED_VERSION_binutils-cross ?= "2.16"
PREFERRED_VERSION_busybox ?= "1.01"
PREFERRED_VERSION_e2fsprogs ?= "1.38"
PREFERRED_VERSION_e2fsprogs-libs ?= "1.35"
PREFERRED_VERSION_e2tools ?= "0.0.16"
PREFERRED_VERSION_expat ?= "1.95.7"
PREFERRED_VERSION_expect ?= "5.43.0"
#PREFERRED_VERSION_fakeroot-native ?= "1.2.13"
PREFERRED_VERSION_gdb ?= "6.2.1"
#PREFERRED_VERSION_genext2fs-native ?= "1.3+1.4rc1"
PREFERRED_VERSION_gettext ?= "0.14.1"
#PREFERRED_VERSION_gettext-native ?= "0.14.1"
#PREFERRED_VERSION_gnu-config-native ?= "0.1cvs20050701"
PREFERRED_VERSION_initscripts ?= "1.0"
PREFERRED_VERSION_ipkg ?= "0.99.154"
PREFERRED_VERSION_ipkg-collateral ?= "1.0"
PREFERRED_VERSION_less ?= "382"
PREFERRED_VERSION_libpam ?= "0.79"
PREFERRED_VERSION_libpcap ?= "0.9.3"
#PREFERRED_VERSION_libtool-native ?= "1.5.10"
PREFERRED_VERSION_linux-hotplug ?= "20040920"
#PREFERRED_VERSION_linux-libc-headers ?= "2.6.12.0"
PREFERRED_VERSION_dsi5200-kernel ?= "2.6.14.6"
#PREFERRED_VERSION_m4-native ?= "1.4.2"
PREFERRED_VERSION_makedevs ?= "1.0.0"
#PREFERRED_VERSION_makedevs-native ?= "1.0.0"
PREFERRED_VERSION_module-init-tools ?= "3.2.2"
PREFERRED_VERSION_module-init-tools-cross ?= "3.2.2"
PREFERRED_VERSION_modutils ?= "2.4.27"
PREFERRED_VERSION_modutils-collateral ?= "1.0"
PREFERRED_VERSION_modutils-initscripts ?= "1.0"
PREFERRED_VERSION_ncurses ?= "5.4"
#PREFERRED_VERSION_ncurses-native ?= "5.4"
PREFERRED_VERSION_netbase ?= "4.21"
PREFERRED_VERSION_ntp ?= "4.2.0"
PREFERRED_VERSION_ntp-ssl ?= "4.2.2p3"
PREFERRED_VERSION_openssh ?= "4.0p1"
PREFERRED_VERSION_openssl ?= "0.9.7e"
PREFERRED_VERSION_pciutils ?= "2.1.11"
#PREFERRED_VERSION_pkgconfig-native ?= "0.15.0"
PREFERRED_VERSION_portmap-5 ?= "9"
PREFERRED_VERSION_postgresql ?= "8.1.1"
PREFERRED_VERSION_procps ?= "3.2.5"
PREFERRED_VERSION_psmisc ?= "21.8"
PREFERRED_VERSION_readline ?= "4.3"
#PREFERRED_VERSION_readline-native ?= "4.3"
PREFERRED_VERSION_setserial ?= "2.17"
PREFERRED_VERSION_shadow ?= "4.0.14"
PREFERRED_VERSION_sudo ?= "1.6.8p12"
PREFERRED_VERSION_sysvinit ?= "2.86"
PREFERRED_VERSION_tcl ?= "8.4.11"
PREFERRED_VERSION_tcpdump ?= "3.9.3"
PREFERRED_VERSION_tftp-hpa ?= "0.32"
PREFERRED_VERSION_tinylogin ?= "1.4"
PREFERRED_VERSION_unixodbc ?= "2.2.11"
PREFERRED_VERSION_update-modules ?= "1.0"
PREFERRED_VERSION_update-rc.d ?= "0.7"
PREFERRED_VERSION_util-linux ?= "2.12q"
PREFERRED_VERSION_xinetd ?= "2.3.13"
PREFERRED_VERSION_zlib ?= "1.2.3"
```

## common/org.openembedded.dev/conf/distro/dsi5200.conf
```bitbake
#@TYPE: Distribution
#@NAME: DSI5200
#@DESCRIPTION: Generic Linux Distribution Configuration

DISTRO_NAME = "DSI5200"
DISTRO_VERSION = "0.1.1"

INHERIT += " package_ipk debian"
TARGET_OS = "linux"
IMAGE_FSTYPES = "ext2.gz"

# Tool chain
PREFERRED_VERSION_binutils ?= "2.15.94.0.1"
PREFERRED_VERSION_binutils-cross ?= "2.15.94.0.1"
PREFERRED_VERSION_gcc ?= "3.3.4"
PREFERRED_VERSION_gcc-initial ?= "3.3.4"
PREFERRED_VERSION_gcc-cross ?= "3.3.4"
PREFERRED_VERSION_gcc-cross-initial ?= "3.3.4"
PREFERRED_VERSION_glibc-initial ?= "2.3.5"
PREFERRED_VERSION_glibc ?= "2.3.5"
PREFERRED_VERSION_glibc-intermediate ?= "2.3.5"
PREFERRED_VERSION_linux-libc-headers ?= "2.6.11.1"

# base apps
PREFERRED_VERSION_grub ?= "0.96"
PREFERRED_VERSION_udev ?= "100"
PREFERRED_VERSION_busybox ?= "1.01"
PREFERRED_VERSION_shadow ?= "4.0.14"
PREFERRED_VERSION_e2fsprogs ?= "1.35"

PREFERRED_VERSION_gdb ?= "6.2.1"
PREFERRED_VERSION_openssl ?= "0.9.7e"
PREFERRED_VERSION_openssh ?= "4.0p1"
PREFERRED_VERSION_tcl ?= "8.4.11"
```

## common/org.openembedded.dev/conf/distro/tauri-unstable.conf
```bitbake
DISTRO = "tauri"
DISTRO_NAME = "Tauri"
DISTRO_VERSION = "unstable-${DATE}"

include conf/distro/familiar.conf

MAINTAINER ?= "Jiff Shen <jiff.shen@avocent.com>"

INHERIT += "package_ipk debian multimachine"
TARGET_OS = "linux"

IMAGE_NAME = "${IMAGE_BASENAME}-${DISTRO_VERSION}-${MACHINE}"

ENABLE_BINARY_LOCALE_GENERATION ?= "1"
PARALLEL_INSTALL_MODULES = "1"
UDEV_DEVFS_RULES = "0"

DISTRO_CHECK := "${@bb.data.getVar("DISTRO_VERSION",d,1) or bb.fatal('Remove this line or set a dummy DISTRO_VERSION if you really want to build an unversioned distro')}"

#DISTRO_TYPE = "debug"
DISTRO_TYPE = "release"

#SRCDATE = 20050331
#SRCDATE = "now"

#Make sure we use 2.6 on machines with a 2.4/2.6 selector
KERNEL = "kernel26"
MACHINE_KERNEL_VERSION = "2.6"

PREFERRED_PROVIDERS += "virtual/${TARGET_PREFIX}gcc-initial:gcc-cross-initial"
PREFERRED_PROVIDERS += "virtual/${TARGET_PREFIX}gcc:gcc-cross"
PREFERRED_PROVIDERS += "virtual/${TARGET_PREFIX}g++:gcc-cross"
PREFERRED_PROVIDERS += "virtual/${TARGET_PREFIX}libc-for-gcc:glibc-intermediate"

PREFERRED_PROVIDER_virtual/libiconv = "glibc"
PREFERRED_PROVIDER_virtual/libintl = "glibc"

PREFERRED_PROVIDER_task-bootstrap = "task-bootstrap"

PREFERRED_PROVIDER_vim = "vim-tiny"

# Toolchain
PREFERRED_VERSION_binutils ?= "2.15.94.0.1"
PREFERRED_VERSION_binutils-cross ?= "2.15.94.0.1"
PREFERRED_VERSION_linux-libc-headers ?= "2.6.11.1"

PREFERRED_VERSION_gcc ?= "4.1.1"
PREFERRED_VERSION_gcc-cross ?= "4.1.1"
PREFERRED_VERSION_gcc-cross-initial ?= "4.1.1"

PREFERRED_VERSION_glibc ?= "2.4"
PREFERRED_VERSION_glibc-intermediate ?= "2.4"
PREFERRED_VERSION_glibc-initial ?= "2.3.5"

# Lib
PREFERRED_VERSION_glib-2.0 ?= "2.6.3"

# App
PREFERRED_VERSION_openssl ?= "0.9.7e"
PREFERRED_VERSION_openssh ?= "4.0p1"
PREFERRED_VERSION_e2fsprogs ?= "1.35"
PREFERRED_VERSION_shadow ?= "4.0.14"
PREFERRED_VERSION_tcl ?= "8.4.11"
PREFERRED_VERSION_busybox ?= "1.2.0"

#
PREFERRED_VERSION_udev ?= "100"
```

## common/org.openembedded.dev/conf/machine/alterpath.conf
```bitbake
#@TYPE: Machine
#@NAME: Cyclades Alterpath Onboard1
#@DESCRIPTION: Machine configuration for the FreeScale MPC85xx CPU  devices

TARGET_ARCH = "powerpc"
include conf/machine/include/tune-ppc85xx.conf

PRODUCT ?= "aspen"
OVERRIDES =. "${PRODUCT}:"

#IPKG_EXTRA_ARCHS = "powerpc_85xx"
#use this for a Cyclades Alterpath OnBoard
PREFERRED_PROVIDER_virtual/kernel ?= "linux-onboard"
PREFERRED_VERSION_linux-onboard ?= "2.6.16"
PREFERRED_VERSION_u-boot ?= "1.1.2"

ROOT_FLASH_SIZE = "100"

MODUTILS = "26"	
PCMCIA_MANAGER = "pcmciautils"

BOOTSTRAP_EXTRA_RDEPENDS += "kernel udev module-init-tools ${PCMCIA_MANAGER}"
BOOTSTRAP_EXTRA_RRECOMMENDS += "kernel-modules kernel-modules-2.6" 

# Used by sysvinit package, rebuild sysvinit after modify these variables
# Set serial console to ttyS0,bitrate 38400. disable tty? VT 
USE_VT = "0"
GETTY = "agetty"
SERIAL_CONSOLE = "9600 ttyS0"
BOOTSTRAP_EXTRA_RDEPENDS += "util-linux"
```

## common/org.openembedded.dev/conf/machine/dsi5200.conf
```bitbake
#@TYPE: Machine
#@NAME: DSI5200 
#@DESCRIPTION: Machine configuration for a Linux running on Avocent DSI5200

TARGET_ARCH = "i686"
PREFERRED_PROVIDER_virtual/kernel = "dsi5200-kernel"
BOOTSTRAP_EXTRA_DEPENDS = "virtual/kernel"

udevdir = "/dev"
OLDEST_KERNEL = "2.6.5"

IMAGE_DEVICE_TABLES = "files/device_table-minimal.txt files/device_table-dsi5200.txt"

# for support Ireland department dtview and Shanghai Mergepoint project, 
# add PRODUCT override, some patches applied to mergepoint will not be used
# by dtview, for example, 'select' 'grub' patches
PRODUCT ?= "mergepoint"
OVERRIDES =. "${PRODUCT}:"

MODUTILS = "26"	
PCMCIA_MANAGER = "pcmciautils"

BOOTSTRAP_EXTRA_RDEPENDS += "kernel udev pciutils module-init-tools"
BOOTSTRAP_EXTRA_RRECOMMENDS += "kernel-modules kernel-modules-2.6" 

# Used by sysvinit package, rebuild sysvinit after modify these variables
# Set serial console to ttyS0,bitrate 38400. disable tty? VT 
USE_VT ?= "0"
GETTY = "agetty"
SERIAL_CONSOLE = "9600 ttyS0"
BOOTSTRAP_EXTRA_RDEPENDS += "util-linux"
```

## common/org.openembedded.dev/conf/machine/i686.conf
```bitbake
#@TYPE: Machine
#@NAME: i686
#@DESCRIPTION: Machine configuration for a Linux running on i686 compatible machines

TARGET_ARCH = "i686"
IPKG_ARCHS = "all i686 x86"
PREFERRED_PROVIDER_virtual/kernel = "linux-x86"
BOOTSTRAP_EXTRA_DEPENDS = "virtual/kernel pciutils udev"
BOOTSTRAP_EXTRA_RDEPENDS = "kernel pciutils udev kernel-modules"

udevdir = "/dev"
OLDEST_KERNEL = "2.6.5"
```

## common/org.openembedded.dev/conf/machine/include/tune-ppc85xx.conf
```bitbake
TARGET_CC_ARCH = "-mcpu=8540 -mbig-endian -me500 -mno-string"
PACKAGE_ARCH = "powerpc"
```
