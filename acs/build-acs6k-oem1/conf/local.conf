## acs/build-acs6k-oem1/conf/local.conf
```bitbake
#
# OpenEmbedded local configuration file (sample)
#
# Please visit the Wiki at http://openembedded.org/ for more info.
#
#
# Be SURE to read this file in its entirety and the GettingStarted page on the
# wiki before proceeding.
#
# Once you have done that, remove the line at the end of this
# file and build away.
# 
# WARNING: lines starting with a space (' ') will result in parse failures.
# Remove '# ' from commented lines to activate them.
#
# NOTE: Do NOT use $HOME in your paths, BitBake does NOT expand ~ for you.  If you
# must have paths relative to your homedir use ${HOME} (note the {}'s there
# you MUST have them for the variable expansion to be done by BitBake).  Your
# paths should all be absolute paths (They should all start with a / after
# expansion.  Stuff like starting with ${HOME} or ${TOPDIR} is ok).

#SRC_DIST_LOCAL = "copy+patch"
#INHERIT += "src_distribute_local"

GSP_FEATURES = ${@os.getenv('GSP_FEATURES', "PRE_TOOLCHAIN NOFETCH")}
TOOLCHAIN = "eldk40-ppc4xx"
require conf/gsp.conf

# Use this to specify where BitBake should place the downloaded sources into
#DL_DIR = ${@os.getenv('DL_DIR', "${HOME}/sources")}

# OEM variable

BUILD_VENDOR = "-fcl"
TARGET_VENDOR = ""

# Uncomment this if you want to use a prebuilt toolchain. You will need to
# provide packages for toolchain and additional libraries yourself. You also
# have to set PATH in your environment to make sure BitBake finds additional binaries.
# Note: You will definitely need to say:
#     ASSUME_PROVIDED += "virtual/arm-linux-gcc-2.95"
# to build any of two Linux 2.4 Embedix kernels,
# i.e. openzaurus-sa-2.4.18 and openzaurus-pxa-2.4.18 - and don't forget
# to rename the binaries as instructed in the Wiki.
#ASSUME_PROVIDED += "virtual/${TARGET_PREFIX}gcc virtual/libc"

# Select between multiple alternative providers, if more than one is eligible.
#PREFERRED_PROVIDERS += " virtual/${TARGET_PREFIX}gcc-initial:gcc-cross-initial"
#PREFERRED_PROVIDERS += " virtual/${TARGET_PREFIX}gcc:gcc-cross"
#PREFERRED_PROVIDERS += " virtual/${TARGET_PREFIX}g++:gcc-cross"

ASSUME_PROVIDED += "file-native bison-native "


# Uncomment this to specify where BitBake should create its temporary files.
# Note that a full build of everything in OpenEmbedded will take GigaBytes of hard
# disk space, so make sure to free enough space. The default TMPDIR is
# <build directory>/tmp
# Don't use symlinks in in the path to avoid problems
#TMPDIR = "/build/${DISTRO}-${MACHINE}"
#TMPDIR = ${@os.getenv('TMPDIR', "${BUILDDIR}/tmp")}

# Uncomment this to specify a machine to build for. See the conf directory
# for machines currently known to OpenEmbedded.
MACHINE = "acs6k_ppc440"

# Use this to specify the target architecture. Note that this is only
# needed when building for a machine not known to OpenEmbedded. Better use
# the MACHINE attribute (see above)
# TARGET_ARCH = "arm"

# Use this to specify the target operating system.  The default is "linux",
# for a normal linux system with glibc. Set this to "linux-uclibc" if you want
# to build a uclibc based system.
# TARGET_OS = "linux"
# TARGET_OS = "linux-uclibc"

# Uncomment this to select a distribution policy. See the conf directory
# for distributions currently known to OpenEmbedded.
# Although they no longer contain version number in the (file-)name
# familiar-unstable and openzaurus-unstable are so called "versioned"
# distros, i.e. they explicitely select specific versions of various
# packages.
# Stay away from unversioned distros unless you really know what you are doing
DISTRO = "acs6000"
PRODUCT = "acs6k-oem1"

AVWORKS = "AVWORKS"
SHARECODE = "GSP"
OVERRIDES =. "${SHARECODE}:${AVWORKS}:"

# So far, angstrom.conf and familiar.conf set ENABLE_BINARY_LOCALE_GENERATION
# to generate binary locale packages at build time using qemu-native and
# thereby guarantee i18n support on all devices. If your build breaks on 
# qemu-native consider disabling ENABLE_BINARY_LOCALE_GENERATION (note that
# this breaks i18n on devices with less than 128MB RAM) or installing
# a working third-party qemu (e.g. provided by your distribution) and
# adding qemu-native to ASSUME_PROVIDED
# ENABLE_BINARY_LOCALE_GENERATION = "0"
# ASSUME_PROVIDED += "qemu-native"

# Uncomment this to select a particular kernel version if supported by 
# your MACHINE setting. Currently only supported by poodle and tosa.
# ZKERNEL_VERSION = "2.6"

# Uncomment one of these to build packages during the build process.
# This is done automatically if you set DISTRO (see above)
# INHERIT = "package_ipk"
# INHERIT = "package_tar"

# Add the required image file system types below. Valid are jffs2, tar, cramfs and ext2
IMAGE_FSTYPES = "ext2.gz"

# Uncomment this to disable the parse cache (not recommended).
# CACHE = ""

# Uncomment this if you want BitBake to emit debugging output
# BBDEBUG = "yes"

# Uncomment these two if you want BitBake to build images useful for debugging. 
# Note that INHIBIT_PACKAGE_STRIP needs a package format to be defined
#DEBUG_BUILD = "1"
#INHIBIT_PACKAGE_STRIP = "1"

DEBUG_OPTIMIZATION = "-O0 -ggdb"

# Uncomment these to build a package such that you can use gprof to profile it.
# NOTE: This will only work with 'linux' targets, not
# 'linux-uclibc', as uClibc doesn't provide the necessary
# object files.  Also, don't build glibc itself with these
# flags, or it'll fail to build.
#
# PROFILE_OPTIMIZATION = "-pg"
# SELECTED_OPTIMIZATION = "${PROFILE_OPTIMIZATION}"
# LDFLAGS =+ "-pg"
LDFLAGS = "-L${STAGING_DIR}/${TARGET_SYS}/lib"
TARGET_CFLAGS =+ "-DAVCT_MULTI_CHAR"

# Uncomment this to enable parallel make.
# This allows make to spawn mutliple processes to take advantage of multiple 
# processors. Useful on SMP machines. This may break some packages - we're
# in the process of marking these so let us know if you find any.
PARALLEL_MAKE = "${@os.getenv('PARALLEL_MAKE', "")}"

# Uncomment this if you want BitBake to emit the log if a build fails.
# BBINCLUDELOGS = "yes"

# PREMIRRORS definition has been moved to gsp.bbclass
#PREMIRRORS := ${@"(http|ftp)://.*/.* svnget://${GSP_REPOS}/sources/trunk/\n"}

# Specifies a location to search for pre-generated tarballs when fetching
# a cvs:// URI. Outcomment this, if you always want to pull directly from CVS.
#CVS_TARBALL_STASH = "http://www.oesources.org/source/current/"

# EDIT THIS FILE and then remove the line below before using!
#REMOVE_THIS_LINE:="${@oe.fatal('Read the comments in your conf/local.conf')}"

# Preferred Versions
# native
PREFERRED_VERSION_glib-2.0-native = "2.12.3"
PREFERRED_VERSION_flex-native = "2.5.33"
PREFERRED_VERSION_openssl-native = "0.9.7e"

# 
PREFERRED_VERSION_linux-acs6000 = "2.6.24"
PREFERRED_VERSION_u-boot = "1.2.0"
PREFERRED_VERSION_unionfs-utils = "1.2"
PREFERRED_VERSION_madwifi-modules = "0.9.3.2"
PREFERRED_VERSION_mtd-utils = "1.0.1"
PREFERRED_VERSION_udev = "124"
PREFERRED_VERSION_update-modules = "1.0"
PREFERRED_VERSION_module-init-tools = "3.3-pre1"
PREFERRED_VERSION_module-init-tools-cross = "3.2.2"
PREFERRED_VERSION_wireless-tools = "29"

# tool chain
PREFERRED_VERSION_gcc = "3.4.4"
PREFERRED_VERSION_gcc-cross = "3.4.4"
PREFERRED_VERSION_gcc-cross-initial = "3.4.4"
PREFERRED_VERSION_binutils = "2.15.94.0.1"
PREFERRED_VERSION_binutils-cross = "2.15.94.0.1"
PREFERRED_VERSION_linux-libc-headers = "2.6.11.1"
PREFERRED_VERSION_glibc = "2.3.5"
PREFERRED_VERSION_glibc-intermediate = "2.3.5"
PREFERRED_VERSION_glibc-initial = "2.3.5"
PREFERRED_VERSION_glib-2.0 = "2.12.3"

# Libs
PREFERRED_VERSION_openssl = "0.9.8j"
PREFERRED_VERSION_openldap = "2.3.28"
PREFERRED_VERSION_openswan = "2.4.9"
PREFERRED_VERSION_xerces-c = "2.7.0"
PREFERRED_VERSION_libdaemon = "0.10"
PREFERRED_VERSION_libnet = "1.1.2.1"
PREFERRED_VERSION_libol = "0.3.18"
PREFERRED_VERSION_libpam = "1.0.2"
PREFERRED_VERSION_libpcap = "0.9.3"
PREFERRED_VERSION_libpcre = "4.4"
PREFERRED_VERSION_libtool = "1.5.10"
PREFERRED_VERSION_libxcrypt = "2.3"
PREFERRED_VERSION_libxml2 = "2.6.26"
PREFERRED_VERSION_ncurses = "5.4"
PREFERRED_VERSION_zlib = "1.2.3"

# App
PREFERRED_VERSION_netbase = "4.21"
PREFERRED_VERSION_openssh = "5.2p1"
PREFERRED_VERSION_syslog-ng = "2.0.6"
PREFERRED_VERSION_sysvinit = "2.86"

PREFERRED_VERSION_apache2 = "2.2.9"
PREFERRED_VERSION_apache2-native = "2.2.9"
PREFERRED_VERSION_base-files = "3.0.14"
PREFERRED_VERSION_base-passwd = "3.5.9"
PREFERRED_VERSION_bash = "3.0"
PREFERRED_VERSION_busybox = "1.5.0"
PREFERRED_VERSION_cli = "2.0.0"
PREFERRED_VERSION_cracklib = "2.8.9"
PREFERRED_VERSION_dosfstools = "2.11"
PREFERRED_VERSION_e2fsprogs = "1.38"
PREFERRED_VERSION_e2fsprogs-libs = "1.35"
PREFERRED_VERSION_ethtool = "4"
PREFERRED_VERSION_eventlog = "0.2.5"
PREFERRED_VERSION_expat = "2.0.0"
PREFERRED_VERSION_flex = "2.5.31"
PREFERRED_VERSION_fm-power-mgmt = "2.0.0"
PREFERRED_VERSION_gmp = "4.2.1"
PREFERRED_VERSION_iproute2 = "2.6.16"
PREFERRED_VERSION_iptables = "1.3.7"
PREFERRED_VERSION_krb5 = "1.6.3"
PREFERRED_VERSION_less = "382"
PREFERRED_VERSION_linux-ftpd-usagi = "0.17"
PREFERRED_VERSION_lrzsz = "0.12.20"
PREFERRED_VERSION_mgetty = "1.1.33"
PREFERRED_VERSION_mindterm = "3.1.2"
PREFERRED_VERSION_minicom = "2.1"
PREFERRED_VERSION_netkit-ftp-usagi = "0.17"
PREFERRED_VERSION_net-snmp = "5.2.1.2"
PREFERRED_VERSION_net-tools = "1.60"
# removed PREFERRED_VERSION_ntpclient = "2006_318"
PREFERRED_VERSION_opie = "2.4"
PREFERRED_VERSION_pam-krb5-fk = "1.0"
PREFERRED_VERSION_pam-ldap = "180"
PREFERRED_VERSION_pam-opie = "0.21"
PREFERRED_VERSION_pam-radius = "1.3.15"
PREFERRED_VERSION_pam-tacplus = "1.2.9"
PREFERRED_VERSION_pam-unix2 = "1.30"
PREFERRED_VERSION_pciutils = "2.1.11"
PREFERRED_VERSION_pcmciautils = "014"
PREFERRED_VERSION_portmap = "5-9"
PREFERRED_VERSION_power-mgmt = "2.0.0"
PREFERRED_VERSION_ppp = "2.4.3"
PREFERRED_VERSION_procps = "3.2.5"
PREFERRED_VERSION_readline = "6.0"
PREFERRED_VERSION_setserial = "2.17"
PREFERRED_VERSION_shadow = "4.0.14"
PREFERRED_VERSION_smslink = "0.56b-3"
PREFERRED_VERSION_socat = "1.6.0.0"
PREFERRED_VERSION_srp = "2.1.2"
PREFERRED_VERSION_sudo = "1.6.8p12"
PREFERRED_VERSION_sysfsutils = "2.0.0"
PREFERRED_VERSION_termcap = "1.3.1"
PREFERRED_VERSION_tftp-hpa = "0.32"
PREFERRED_VERSION_timezone-data = "2007f"
PREFERRED_VERSION_update-rc.d = "0.7"
PREFERRED_VERSION_usbctl = "1.0"
PREFERRED_VERSION_util-linux = "2.12r"
PREFERRED_VERSION_vim-tiny = "7.0"
PREFERRED_VERSION_vlan = "1.8"
PREFERRED_VERSION_wget = "1.9.1"
PREFERRED_VERSION_wide-dhcpv6 = "20070507"
PREFERRED_VERSION_xinetd = "2.3.13"
PREFERRED_VERSION_ypbind-mt = "1.19"
PREFERRED_VERSION_yp-tools = "2.10"

# vim: syntax=bitbake
```

## common/com.avocent.dev/conf/distro/acs6000.conf
```bitbake
MAINTAINER ?= "Regina Kodato <regina.kodato@avocent.com>"

DISTRO = "acs6000"
DISTRO_NAME = "ACS6000"
DISTRO_VERSION = "2.2.0.6-${DATE}"


INHERIT += "package_ipk debian multimachine" 
TARGET_OS = "linux"

IMAGE_NAME = "${IMAGE_BASENAME}-${DISTRO_VERSION}-${DISTRO}"

ENABLE_BINARY_LOCALE_GENERATION ?= "1"
PARALLEL_INSTALL_MODULES = "1"
UDEV_DEVFS_RULES = "0"

DISTRO_CHECK := "${@bb.data.getVar("DISTRO_VERSION",d,1) or bb.fatal('Remove this line or set a dummy DISTRO_VERSION if you really want to build an unversioned distro')}"

#DISTRO_TYPE = "debug"
DISTRO_TYPE = "release"

#SRCDATE = 20050331
#SRCDATE = "now"

#Make sure we use 2.6 on machines with a 2.4/2.6 selector
KERNEL = "kernel26"
MACHINE_KERNEL_VERSION = "2.6"
PREFERRED_VERSION_u-boot = "1.2.0"

PREFERRED_PROVIDERS += "virtual/${TARGET_PREFIX}gcc-initial:gcc-cross-initial"
PREFERRED_PROVIDERS += "virtual/${TARGET_PREFIX}gcc:gcc-cross"
PREFERRED_PROVIDERS += "virtual/${TARGET_PREFIX}g++:gcc-cross"
PREFERRED_PROVIDERS += "virtual/${TARGET_PREFIX}libc-for-gcc:glibc-intermediate"

PREFERRED_PROVIDERS += "libstdc++:gcc-cross"

PREFERRED_PROVIDER_virtual/libiconv = "glibc"
PREFERRED_PROVIDER_virtual/libintl = "glibc"

PREFERRED_PROVIDER_task-bootstrap = "task-bootstrap"

# Toolchain
#PREFERRED_VERSION_gcc ?= "3.3.4"
#PREFERRED_VERSION_gcc-cross ?= "3.3.4"
#PREFERRED_VERSION_gcc-cross-initial ?= "3.3.4"
PREFERRED_VERSION_gcc ?= "3.4.4"
PREFERRED_VERSION_gcc-cross ?= "3.4.4"
PREFERRED_VERSION_gcc-cross-initial ?= "3.4.4"
PREFERRED_VERSION_binutils ?= "2.15.94.0.1"
PREFERRED_VERSION_binutils-cross ?= "2.15.94.0.1"
PREFERRED_VERSION_linux-libc-headers ?= "2.6.11.1"
PREFERRED_VERSION_glibc ?= "2.3.5"
PREFERRED_VERSION_glibc-intermediate ?= "2.3.5"
PREFERRED_VERSION_glibc-initial ?= "2.3.5"
PREFERRED_VERSION_flex-native ?= "2.5.33"

# Lib
PREFERRED_VERSION_openssl-native ?= "0.9.7e"
PREFERRED_VERSION_openssl ?= "0.9.8e"
PREFERRED_VERSION_glib-2.0 ?= "2.6.3"
PREFERRED_VERSION_xerces-c ?= "2.7.0"
PREFERRED_VERSION_libxml2 ?= "2.6.26"
PREFERRED_VERSION_libxslt ?= "1.1.12"

# App
PREFERRED_VERSION_udev ?= "100"
PREFERRED_VERSION_tinylogin ?= "1.5.0"
PREFERRED_VERSION_e2fsprogs ?= "1.38"
PREFERRED_VERSION_libpam ?= "0.79"
PREFERRED_VERSION_shadow ?= "4.0.14"
PREFERRED_VERSION_busybox ?= "1.5.0"

PREFERRED_VERSION_procps ?= "3.2.5"
PREFERRED_VERSION_bash ?= "3.0"
PREFERRED_VERSION_xinetd ?= "2.3.13"
PREFERRED_VERSION_openssh ?= "4.6p1"

PREFERRED_VERSION_tcl ?= "8.4.11"
PREFERRED_VERSION_bind ?= "9.3.1"
PREFERRED_VERSION_unixodbc ?= "2.2.11"
PREFERRED_VERSION_postgresql ?= "8.1.4"

PREFERRED_VERSION_vlan ?= "1.8"
PREFERRED_VERSION_iptables ?= "1.3.7"
PREFERRED_VERSION_wide-dhcpv6 ?= "20070507"
PREFERRED_VERSION_tftp-hpa ?= "0.32"
PREFERRED_VERSION_netkit-ftp ?= "0.17"
PREFERRED_VERSION_apache ?= "2.0.59"

PREFERRED_VERSION_less ?= "382"
PREFERRED_VERSION_vim ?= "7.0"
PREFERRED_VERSION_vim-tiny ?= "7.0"

PREFERRED_VERSION_strace ?= "4.5.14"
PREFERRED_VERSION_gdb ?= "6.4"
```

## common/com.avocent.dev/conf/machine/acs6k_ppc440.conf
```bitbake
#@TYPE: Machine
#@NAME: Avocent ACS6000
#@DESCRIPTION: Machine configuration for the AMCC PPC440EPX CPU  devices

TARGET_ARCH = "powerpc"
include conf/machine/include/tune-ppc440.conf

PRODUCT ?= "golden_gate"
OVERRIDES =. "${PRODUCT}:"

PREFERRED_PROVIDER_virtual/kernel = "linux-acs6000"

#ROOT_FLASH_SIZE = "100"

MODUTILS = "26"	
PCMCIA_MANAGER = "pcmciautils"
BOOTSTRAP_EXTRA_RDEPENDS += "kernel udev module-init-tools ${PCMCIA_MANAGER}"
BOOTSTRAP_EXTRA_RRECOMMENDS += "kernel-modules kernel-modules-2.6" 

# Used by sysvinit package, rebuild sysvinit after modify these variables
# Set serial console to ttyS0,bitrate 38400. disable tty? VT 
USE_VT = "0"
GETTY = "getty"
SERIAL_CONSOLE = "ttyS0"
BOOTSTRAP_EXTRA_RDEPENDS += "util-linux"
```

## common/com.avocent.dev/conf/machine/amazon.conf
```bitbake
#@TYPE: Machine
#@NAME: Huntsville Amazon
#@DESCRIPTION: Machine configuration for the FreeScale MPC85xx CPU  devices

TARGET_ARCH = "powerpc"
include conf/machine/include/tune-ppc85xx.conf

PRODUCT ?= "amazon"
OVERRIDES =. "${PRODUCT}:"

IMAGE_FSTYPES += " tar.gz"

#IPKG_EXTRA_ARCHS = "powerpc_85xx"
#use this for a Huntsville Amazon
PREFERRED_PROVIDER_virtual/kernel = "linux-amazon"
PREFERRED_VERSION_u-boot = "1.1.2"
PREFERRED_VERSION_glib-2.0 ?= "2.12.3"
PREFERRED_VERSION_glib-2.0-native ?= "2.12.3"

ROOT_FLASH_SIZE = "100"

MODUTILS = "26"	
PCMCIA_MANAGER = "pcmciautils"

BOOTSTRAP_EXTRA_RDEPENDS += "kernel udev module-init-tools ${PCMCIA_MANAGER}"
BOOTSTRAP_EXTRA_RRECOMMENDS += "kernel-modules kernel-modules-2.6" 

# Used by sysvinit package, rebuild sysvinit after modify these variables
# Set serial console to ttyS0,bitrate 38400. disable tty? VT 
USE_VT = "0"
GETTY = "agetty"
SERIAL_CONSOLE = "9600 ttyS0"
BOOTSTRAP_EXTRA_RDEPENDS += "util-linux"
```

## common/com.avocent.dev/conf/machine/include/tune-ppc440fp.conf
```bitbake
TARGET_CC_ARCH = "-mtune=440fp -mbig-endian -mpowerpc -mhard-float"
PACKAGE_ARCH = "powerpc"
```
